#include "LPC11Uxx.h"
#include "bit.h"
#include "system_LPC11Uxx.h"
#include <stdint.h>


#define PIN_TXD 19
#define PIN_RXD 18

void serialInit(void){

	BitSet(LPC_SYSCON->SYSAHBCLKCTRL, 16);
	LPC_IOCON->PIO0_18 |= 0x1; //SELECIONA A FUNÇÃO DE RXD DO PINO
	LPC_IOCON->PIO0_19 |= 0X1; //SELICIONA A FUNÇÃO DE TXD DO PINO

	BitSet(LPC_SYSCON->SYSAHBCLKCTRL, 12); // ATIVA O CLOCK DA USART
	LPC_SYSCON->UARTCLKDIV = 1; // CONFIGURA O CLOCK DA UART PARA PLCK/1 = 12MHZ

	BitClr(LPC_USART->MCR, 4); // DESABILITA O MODO DE LOOPBACK PARA DIAGNOSTICOS

	BitClr(LPC_USART->MCR, 6); // DESABILITA AUTO-RST (PINO NÃO USADO NO PROJETO)
	BitClr(LPC_USART->MCR, 7); // DESABILITA AUTO-CTS (PINO NÃO USADO NO PROJETO)

	BitSet(LPC_USART->FCR, 0); // (FIFO ENABLE) HABILITA AMBOS OS USART RX E TX FIFOs E ACESSO A FCR[1:7]

	LPC_USART->LCR |= 0x3; // ( WLS = 0X2) CONFIGURA O TAMANHO DO DADO ENVIADO POR FRAME PARA UM CARACTER DE 8 BITS
	BitClr(LPC_USART->LCR, 2); // (SBS = 0) CONFIGURA PARA 1 FRAME TER 1 BIT DE STOP
	BitClr(LPC_USART->LCR, 3); // (PARITY ENABLE = 0) DESABILITA O BIT DE PARIDADE

	//LPC_USART->LCR |= 0x00; // (PS = 0X0) HABILITA A ODD PARITY

	LPC_USART->FDR |= 0x1; // DIVADDVAL = 1 (ou usar 0x5)
	LPC_USART->FDR |= 0x20; // MULVAL = 2 (ou usar 0x80)
	BitSet(LPC_USART->LCR, 7); // HABILITA O DLAB (DIVISOR LATCH ACESS BIT)
	LPC_USART->DLM |= 0x0; // CONFIGURA O DIVISOR LATCH
	LPC_USART->DLL |= 0x34; // CONFIGURA O DIVISOR LATCH (ou usar 0x04)
	BitClr(LPC_USART->LCR, 7); // DESABILITA O DLAB (DIVISOR LATCH ACESS BIT)

	BitSet(LPC_USART->TER, 7); //HABILITA A TRANSMISSÃO DE DADOS

}

void sendChar(char c){
	while( !(BitTst(LPC_USART->LSR, 6)) );

	LPC_USART->THR = c;

}


void sendString(char *s){
	int i = 0;

	while(s[i] != '\0'){
		sendChar(s[i]);
		i++;
	}
}

char readChar(void){
	if (BitTst(LPC_USART->LSR, 0)){

		return LPC_USART->RBR;
	}
	else{
		return 0;
	}
}



